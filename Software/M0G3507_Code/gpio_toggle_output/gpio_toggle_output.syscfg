/**
 * @cliArgs --device "MSPM0G350X" --part "Default" --package "LQFP-64(PM)" --product "mspm0_sdk@2.10.00.04"
 * @versions {"tool":"1.26.2+4477"}
 */

/**
 * Import the modules used in this configuration.
 */
const GPIO   = scripting.addModule("/ti/driverlib/GPIO", {}, false);
const GPIO1  = GPIO.addInstance();
const GPIO2  = GPIO.addInstance();
const GPIO3  = GPIO.addInstance();
const GPIO4  = GPIO.addInstance();
const GPIO5  = GPIO.addInstance();
const SYSCTL = scripting.addModule("/ti/driverlib/SYSCTL");

/**
 * Write custom configuration values to the imported modules.
 */
GPIO1.$name                         = "GPIO_LEDS";
GPIO1.port                          = "PORTB";
GPIO1.associatedPins[0].$name       = "USER_LED";
GPIO1.associatedPins[0].assignedPin = "14";

const Board = scripting.addModule("/ti/driverlib/Board", {}, false);

GPIO2.$name                   = "ADG704_EN";
GPIO2.associatedPins[0].$name = "PIN_0";

GPIO3.$name                   = "ADG704_A0";
GPIO3.associatedPins[0].$name = "PIN_1";

GPIO4.$name                   = "ADG704_A1";
GPIO4.associatedPins[0].$name = "PIN_2";

GPIO5.$name                              = "GPIO_KEY";
GPIO5.port                               = "PORTA";
GPIO5.associatedPins[0].$name            = "PIN_3";
GPIO5.associatedPins[0].direction        = "INPUT";
GPIO5.associatedPins[0].internalResistor = "PULL_UP";

SYSCTL.forceDefaultClkConfig = true;
SYSCTL.clockTreeEn           = true;

/**
 * Pinmux solution for unlocked pins/peripherals. This ensures that minor changes to the automatic solver in a future
 * version of the tool will not impact the pinmux you originally saw.  These lines can be completely deleted in order to
 * re-solve from scratch.
 */
GPIO1.associatedPins[0].pin.$suggestSolution = "PB14";
Board.peripheral.$suggestSolution            = "DEBUGSS";
Board.peripheral.swclkPin.$suggestSolution   = "PA20";
Board.peripheral.swdioPin.$suggestSolution   = "PA19";
GPIO2.associatedPins[0].pin.$suggestSolution = "PB13";
GPIO3.associatedPins[0].pin.$suggestSolution = "PB15";
GPIO4.associatedPins[0].pin.$suggestSolution = "PB16";
GPIO5.associatedPins[0].pin.$suggestSolution = "PA12";
